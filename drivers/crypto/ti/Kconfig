## drivers/crypto/ti/Kconfig
```kconfig
# SPDX-License-Identifier: GPL-2.0-only
config CRYPTO_DEV_TI_DTHEV2
	tristate "Support for TI DTHE V2 cryptography engine"
	depends on ARCH_K3 || COMPILE_TEST
	select CRYPTO_ENGINE
	select CRYPTO_SKCIPHER
	select CRYPTO_ECB
	select CRYPTO_CBC
	select CRYPTO_CTR
	select CRYPTO_XTS
	select CRYPTO_GCM
	select CRYPTO_CCM
	select CRYPTO_SHA256
	select CRYPTO_SHA512
	select CRYPTO_MD5
	select CRYPTO_HMAC
	select SG_SPLIT
	help
	  This enables support for the TI DTHE V2 hw cryptography engine
	  which can be found on TI K3 SOCs. Selecting this enables use
	  of hardware offloading for cryptographic algorithms on
	  these devices, providing enhanced resistance against side-channel
	  attacks.

config CRYPTO_DEV_TI_MCRC64
	tristate "Texas Instruments MCRC64 engine support"
	depends on ARCH_K3 || COMPILE_TEST
	select CRYPTO_HASH
	select CRYPTO_CRC64_ISO3309
	help
	  This enables support for the MCRC64 engine
	  which can be found on all AM62* and J722S devices.
	  MCRC64 engine calculates 64-bit cyclic redundancy checks (CRC)
	  according to the ISO 3309 standard.
```
