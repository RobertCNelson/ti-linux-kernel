## Documentation/devicetree/bindings/clock/ti,cdce6214.yaml
```yaml
# SPDX-License-Identifier: (GPL-2.0-only OR BSD-2-Clause)
%YAML 1.2
---
$id: http://devicetree.org/schemas/clock/ti,cdce6214.yaml#
$schema: http://devicetree.org/meta-schemas/core.yaml#

title: TI CDCE6214 programmable clock generator with PLL

maintainers:
  - Sascha Hauer <s.hauer@pengutronix.de>

description: >
  Ultra-Low Power Clock Generator With One PLL, Four Differential Outputs,
  Two Inputs, and Internal EEPROM

  - CDCE6214: https://www.ti.com/product/CDCE6214

properties:
  compatible:
    enum:
      - ti,cdce6214

  reg:
    maxItems: 1

  clocks:
    minItems: 1
    maxItems: 2

  clock-names:
    minItems: 1
    items:
      - enum: [ priref, secref ]
      - const: secref

  '#clock-cells':
    const: 1

patternProperties:
  '-pins$':
    type: object
    additionalProperties: false

    patternProperties:
      '^conf':
        type: object
        additionalProperties: false
        $ref: /schemas/pinctrl/pincfg-node.yaml#

        properties:
          pins:
            items:
              enum: [priref, secref, out0, out1, out2, out3, out4 ]

          ti,io-standard:
            description: |
              1: CMOS
              2: LVDS
              3: Low-Power HCSL
              4: XTAL mode
              5: differential
            enum: [1, 2, 3, 4, 5]
            $ref: /schemas/types.yaml#/definitions/uint32

          ti,xo-cload-femtofarads:
            description: Load capacity for XO in Femtofarad

          ti,xo-bias-microamp:
            description: Bias current setting of the XO

          ti,cmosp-mode:
            description: |
              Driving mode for CMOSP output:
              1: Low Polarity
              2: High Polarity
              3: Disable
            $ref: /schemas/types.yaml#/definitions/uint32
            maximum: 3

          ti,cmosn-mode:
            description: |
              Driving mode for CMOSN output:
              1: Low Polarity
              2: High Polarity
              3: Disable
            $ref: /schemas/types.yaml#/definitions/uint32
            maximum: 3

        allOf:
          - if:
              properties:
                pins:
                  contains:
                    const: priref
            then:
              properties:
                io-standard:
                  enum: [ 1, 5 ]

          - if:
              properties:
                pins:
                  contains:
                    const: secref
            then:
              properties:
                io-standard:
                  enum: [ 1, 4, 5 ]

          - if:
              properties:
                pins:
                  contains:
                    const: out0
            then:
              properties:
                io-standard:
                  enum: [ 1 ]

          - if:
              properties:
                pins:
                  contains:
                    enum:
                      - out1
                      - out4
            then:
              properties:
                io-standard:
                  enum: [ 1, 2, 3 ]

          - if:
              properties:
                pins:
                  contains:
                    enum:
                      - out2
                      - out3
            then:
              properties:
                io-standard:
                  enum: [ 2, 3 ]

        required:
          - pins

required:
  - compatible
  - reg
  - clocks
  - '#clock-cells'

additionalProperties: false

examples:
  - |
    #include <dt-bindings/clock/ti,cdce6214.h>
    i2c {
        #address-cells = <1>;
        #size-cells = <0>;

        clock-generator@67 {
            compatible = "ti,cdce6214";
            reg = <0x67>;
            #clock-cells = <1>;
            clocks = <&clock_ref25m>;
            clock-names = "priref";

            cdce6214_pins: cdce6214-pins {
                conf1 {
                    pins = "secref";
                    ti,io-standard = <CDCE6214_IOSTD_XTAL>;
                    ti,xo-cload-femtofarads = <8100>;
                    ti,xo-bias-microamp = <100>;
                };

                conf2 {
                    pins = "out1";
                    ti,io-standard = <CDCE6214_IOSTD_CMOS>;
                    ti,cmosp-mode = <CDCE6214_CMOS_MODE_HIGH>;
                    ti,cmosn-mode = <CDCE6214_CMOS_MODE_LOW>;
                };

                conf3 {
                    pins = "out4";
                    ti,io-standard = <CDCE6214_IOSTD_CMOS>;
                    ti,cmosp-mode = <CDCE6214_CMOS_MODE_HIGH>;
                    ti,cmosn-mode = <CDCE6214_CMOS_MODE_LOW>;
                };
            };
        };
    };
```

## Documentation/devicetree/bindings/memory-controllers/ti,am62a-fsas.yaml
```yaml
# SPDX-License-Identifier: (GPL-2.0-only OR BSD-2-Clause)
# Copyright (C) 2026 Texas Instruments Incorporated
%YAML 1.2
---
$id: http://devicetree.org/schemas/memory-controllers/ti,am62a-fsas.yaml#
$schema: http://devicetree.org/meta-schemas/core.yaml#

title: Texas Instruments K3 Flash SubSystem FSAS

maintainers:
  - Santhosh Kumar K <s-k6@ti.com>

description:
  The FSS_FSAS_GENREGS block is a TI wrapper inside the Flash SubSystem (FSS).

properties:
  compatible:
    const: ti,am62a-fsas

  reg:
    maxItems: 1

required:
  - compatible
  - reg
  - clocks
  - power-domains

additionalProperties: false

examples:
  - |
    bus {
        #address-cells = <2>;
        #size-cells = <2>;

        fsas@fc10000 {
            compatible = "ti,am62a-fsas";
            reg = <0x00 0x0fc10000 0x00 0x100>;
        };
    };
```

## Documentation/devicetree/bindings/mux/ti,am62l-event-mux-router.yaml
```yaml
# SPDX-License-Identifier: (GPL-2.0-only OR BSD-2-Clause)
%YAML 1.2
---
$id: http://devicetree.org/schemas/mux/ti,am62l-event-mux-router.yaml#
$schema: http://devicetree.org/meta-schemas/core.yaml#

title: TI Event Multiplexer on K3 SoCs

maintainers:
  - Rahul Sharma <r-sharma3@ti.com>

description:
  The TI K3 mux routers which route the GPIO input events or Time
  Sync events b/w peripherals instead of routing to a CPU.

allOf:
  - $ref: mux-controller.yaml#

properties:
  compatible:
    const: ti,am62l-event-mux-router

  reg:
    description: Register base address and size.
    maxItems: 1

  '#mux-control-cells':
    const: 1
    description:
      Number of cells in a mux control specifier. This should be 1.
      The cell specifies which mux control to use (0-based index).

  mux-reg-mask-val:
    $ref: /schemas/types.yaml#/definitions/uint32-matrix
    items:
      items:
        - description: Register offset (relative to reg base or syscon)
        - description: Bit mask for the mux control bits
        - description: Value to write when mux is active (state 1)
    minItems: 1
    description: |
      Array of triplets specifying register offset, mask, and value for each
      mux control. Each triplet contains:
      - register offset (relative to reg base or syscon)
      - bit mask for the mux control bits
      - value to write when mux is active (state 1)

  idle-states:
    $ref: /schemas/types.yaml#/definitions/uint32-array
    description: |
      Idle state for each mux control. Each entry corresponds to a mux control:
      - 0: clear masked bits when idle, also refers to inactive state
      - 1: set configured value when idle, also refers to active state
      - MUX_IDLE_AS_IS (-1): keep current state when idle

      If not specified, defaults to MUX_IDLE_AS_IS for all controls.
      The idle state is applied at probe time and when no consumer is using the
      mux.

required:
  - compatible
  - reg
  - '#mux-control-cells'
  - mux-reg-mask-val
  - idle-states

additionalProperties: false

examples:
  - |
    // Example 1: TI AM62L GPIO Mux Router
    mux-controller@a00000 {
        compatible = "ti,am62l-event-mux-router";
        reg = <0xa00000 0x400>;
        #mux-control-cells = <1>;

        //Mux Register addresses: 0xa00004 + (J x 4)
        mux-reg-mask-val = <0x40 0x000ff 0x00028>; /* GPIO0_40->BCDMA trigger 15 */
        idle-states = <0>;
    };
```

## Documentation/devicetree/bindings/soc/ti/ti,wkup-src-notify.yaml
```yaml
# SPDX-License-Identifier: (GPL-2.0-only OR BSD-2-Clause)
# Copyright (C) 2026 Texas Instruments Incorporated - https://www.ti.com/
%YAML 1.2
---
$id: http://devicetree.org/schemas/soc/ti/ti,wkup-src-notify.yaml#
$schema: http://devicetree.org/meta-schemas/core.yaml#

title: TI K3 Wakeup Source Notify

maintainers:
  - Kendall Willis <k-willis@ti.com>

description:
  On TI AM62L SoC, the firmware exposes wakeup reason bitmask, last
  last entered low power mode, and pad pin that woke up the system
  via an SMC call after the system resumes from a low power state. This
  driver reads the wakeup reason bitmask and injects the corresponding
  Linux virtual IRQs so that wakeup source drivers (GPIO controllers,
  UARTs, RTC, etc.) can be notified.

  Each entry in ti,wkup-sources maps a wakeup source bitmask to a device,
  an optional interrupt index within that device's interrupt list, and a
  an optional wakeup pin. The wakeup pin is only valid for IO daisy-chain
  wakeup sources, otherwise the value mapped is ignored.

properties:
  compatible:
    const: ti,wkup-src-notify

  ti,wkup-sources:
    $ref: /schemas/types.yaml#/definitions/phandle-array
    description:
      List of wakeup sources. Each entry is a phandle to the wakeup source
      device followed by three cells.
    items:
      items:
        - description: Phandle to the wakeup source device.
        - description:
            Wakeup source bitmask. This value is ANDed against the bitmask
            returned by the firmware SMC call to determine if this source
            caused the wakeup.
          minimum: 1
        - description:
            Index into the wakeup source device's interrupts list to use
            as the virtual IRQ to inject on wakeup if applicable.
          minimum: 0
        - description:
            Wakeup pin. Used to identify which pad pin triggered an
            IO daisy-chain wakeup. Set to 0 for non-IO-daisy-chain sources.
          minimum: 0

required:
  - compatible
  - ti,wkup-sources

additionalProperties: false

examples:
  - |
    wkup-src-notify {
        compatible = "ti,wkup-src-notify";
        ti,wkup-sources =
            <&wkup_uart0 0x2 0 0>,          /* WKUP_USART0 */
            <&wkup_rtc0  0x80 0 0>,         /* WKUP_RTC0 */
            <&uart0      0x10000 0 0x1b4>;  /* MAIN_IO_DAISY_CHAIN, pin 0x1b4 */
    };
...
```
