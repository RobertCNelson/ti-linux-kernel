## Documentation/devicetree/bindings/pci/pcie-synopsys.txt
```
Synopsys PCI RC IP Prototyping Kit
----------------------------------

This is the reference platform driver to be used in the Synopsys PCI Root
Complex IP Prototyping Kit.

Required properties:
- compatible: set to "snps,pcie-synopsys";
- reg: base address and length of the pcie controller registers.
- #address-cells: set to <3>
- #size-cells: set to <2>
- device_type: set to "pci"
- ranges: ranges for the PCI memory and I/O regions.
- interrupts: one interrupt source for MSI interrupts, followed by interrupt
	source for hardware related interrupts.
- #interrupt-cells: set to <1>
- num-lanes: set to <1>;

Example configuration:

	pcie: pcie@0xdffff000 {
		compatible = "snps,pcie-synopsys";
		reg = <0xdffff000 0x1000>;
		#address-cells = <3>;
		#size-cells = <2>;
		device_type = "pci";
		ranges = <0x00000800 0 0xd0000000 0xd0000000 0 0x00002000>,
			 <0x81000000 0 0x00000000 0xde000000 0 0x00010000>,
			 <0x82000000 0 0xd0400000 0xd0400000 0 0x0d000000>;
		interrupts = <25>, <24>;
		#interrupt-cells = <1>;
		num-lanes = <1>;
	};
```

## Documentation/devicetree/bindings/pci/ti-pci.txt
```
TI PCI Controllers

PCIe DesignWare Controller
 - compatible: Should be "ti,dra7-pcie" for RC
	       Should be "ti,dra7-pcie-ep" for EP
 - phys : list of PHY specifiers (used by generic PHY framework)
 - phy-names : must be "pcie-phy0", "pcie-phy1", "pcie-phyN".. based on the
	       number of PHYs as specified in *phys* property.
 - ti,hwmods : Name of the hwmod associated to the pcie, "pcie<X>",
	       where <X> is the instance number of the pcie from the HW spec.
 - num-lanes as specified in ../designware-pcie.txt

HOST MODE
=========
 - reg : Two register ranges as listed in the reg-names property
 - reg-names : The first entry must be "ti-conf" for the TI-specific registers
	       The second entry must be "rc-dbics" for the DesignWare PCIe
	       registers
	       The third entry must be "config" for the PCIe configuration space
 - interrupts : Two interrupt entries must be specified. The first one is for
		main interrupt line and the second for MSI interrupt line.
 - #address-cells,
   #size-cells,
   #interrupt-cells,
   device_type,
   ranges,
   interrupt-map-mask,
   interrupt-map : as specified in ../designware-pcie.txt

DEVICE MODE
===========
 - reg : Four register ranges as listed in the reg-names property
 - reg-names : "ti-conf" for the TI-specific registers
	       "ep_dbics" for the standard configuration registers as
		they are locally accessed within the DIF CS space
	       "ep_dbics2" for the standard configuration registers as
		they are locally accessed within the DIF CS2 space
	       "addr_space" used to map remote RC address space
 - interrupts : one interrupt entries must be specified for main interrupt.
 - num-ib-windows : number of inbound address translation windows
 - num-ob-windows : number of outbound address translation windows
 - ti,syscon-unaligned-access: phandle to the syscon DT node. The 1st argument
			       should contain the register offset within syscon
			       and the 2nd argument should contain the bit field
			       for setting the bit to enable unaligned
			       access.

Optional Property:
 - gpios : Should be added if a GPIO line is required to drive PERST# line

NOTE: Two DT nodes may be added for each PCI controller; one for host
mode and another for device mode. So in order for PCI to
work in host mode, EP mode DT node should be disabled and in order to PCI to
work in EP mode, host mode DT node should be disabled. Host mode and EP
mode are mutually exclusive.

Example:
axi {
	compatible = "simple-bus";
	#size-cells = <1>;
	#address-cells = <1>;
	ranges = <0x51000000 0x51000000 0x3000
		  0x0	     0x20000000 0x10000000>;
	pcie@51000000 {
		compatible = "ti,dra7-pcie";
		reg = <0x51000000 0x2000>, <0x51002000 0x14c>, <0x1000 0x2000>;
		reg-names = "rc_dbics", "ti_conf", "config";
		interrupts = <0 232 0x4>, <0 233 0x4>;
		#address-cells = <3>;
		#size-cells = <2>;
		device_type = "pci";
		ranges = <0x81000000 0 0          0x03000 0 0x00010000
			  0x82000000 0 0x20013000 0x13000 0 0xffed000>;
		#interrupt-cells = <1>;
		num-lanes = <1>;
		ti,hwmods = "pcie1";
		phys = <&pcie1_phy>;
		phy-names = "pcie-phy0";
		interrupt-map-mask = <0 0 0 7>;
		interrupt-map = <0 0 0 1 &pcie_intc 1>,
				<0 0 0 2 &pcie_intc 2>,
				<0 0 0 3 &pcie_intc 3>,
				<0 0 0 4 &pcie_intc 4>;
		pcie_intc: interrupt-controller {
			interrupt-controller;
			#address-cells = <0>;
			#interrupt-cells = <1>;
		};
	};
};

PCI Controller in DRA8:
 - compatible: Should be "ti,k3-dra8-pcie"
 - reg : Two register ranges as listed in the reg-names property
 - reg-names : The first entry must be "intd_cfg" used for handling legacy
     interrupts. The second entry must be "user_cfg" and it has registers
     for enabling the LTSSM
 - #address-cells : should be 1 to indicate the child node should use 1 cell
     for address
 - #size-cells : should be 1 to indicate the child node should use 1 cell for
     size
 - #interrupt-cells : should be 1 to indicate interrupt-map has 1 cell for
     interrupt
 - interrupt-map-mask : As mentioned in "Open Firmware Recommended Practice:
     Interrupt Mapping" document
 - interrupt-map : As mentioned in "Open Firmware Recommended Practice:
     Interrupt Mapping" document
 - mode : should be <PCI_MODE_RC> for RC mode and should be <PCI_MODE_EP> for
     EP mode

It should have two child nodes, one for RC mode (pcie) and the other for EP
mode (pcie-ep). The child node for RC should follow the binding in
cdns,cdns-pcie-host.txt. The child node for the EP should follow the binding
in cdns,cdns-pcie-ep.txt

It should also have an interrupt controller device node
(legacy-interrupt-controller) for Legacy IRQ chip with the following properties
 - interrupt-controller: To indicate this is an interrupt controller dt node
 - interrupt-cells: should be set to 1
 - interrupt-parent: Parent interrupt controller phandle
 - interrupts: GIC interrupt lines connected to PCI Legacy interrupt lines

Example:
	pcie0: pcie@2900000 {
		compatible = "ti,k3-dra8-pcie";
		reg = <0x02900000 0x1000>,
		      <0x02907000 0x400>;
		reg-names = "intd_cfg", "user_cfg";
		#address-cells = <1>;
		#size-cells = <1>;
		ranges;
		#interrupt-cells = <1>;
		interrupt-map-mask = <0 7>;
		interrupt-map = <0 1 &pcie0_intc 0>, /* INT A */
				<0 2 &pcie0_intc 0>, /* INT B */
				<0 3 &pcie0_intc 0>, /* INT C */
				<0 4 &pcie0_intc 0>; /* INT D */
		status = "disabled";

		pcie0_rc: pcie@d000000 {
			compatible = "cdns,cdns-pcie-host";
			reg = <0x0d000000 0x00800000>,
			      <0x10000000 0x00001000>,
			      <0x10000000 0x08000000>;
			reg-names = "reg", "cfg", "mem";
			device_type = "pci";
			#address-cells = <3>;
			#size-cells = <2>;
			bus-range = <0x0 0xff>;
			linux,pci-domain = <0>;
			cdns,max-outbound-regions = <16>;
			cdns,no-bar-match-nbits = <32>;
			vendor-id = /bits/ 16 <0x17cd>;
			device-id = /bits/ 16 <0x0200>;
			msi-map = <0x0 &gic_its 0x0 0x1000>;
			ranges = <0x01000000 0x0 0x10001000  0x10001000  0x0 0x0010000>,
				 <0x02000000 0x0 0x10011000  0x10011000  0x0 0x7fef000>;
		};

		pcie0_ep: pcie-ep@d000000 {
			compatible = "cdns,cdns-pcie-ep";
			reg = <0x0d000000 0x00800000>,
			      <0x10000000 0x08000000>;
			reg-names = "reg", "mem";
			cdns,max-outbound-regions = <16>;
			max-functions = /bits/ 8 <2>;
		};

		pcie0_intc: legacy-interrupt-controller {
			interrupt-controller;
			#interrupt-cells = <1>;
			interrupt-parent = <&gic500>;
			interrupts = <GIC_SPI 312 IRQ_TYPE_EDGE_RISING>;
		};
	};
```

## Documentation/devicetree/bindings/phy/omap-phy.txt
```
OMAP PHY

OMAP USB2 PHY

Required properties:
 - compatible: Should be "ti,omap-usb2"
 - reg : Address and length of the register set for the device.
 - #phy-cells: determine the number of cells that should be given in the
   phandle while referencing this phy.
 - clocks: phandle to PHY clocks i.e. 32KHz wakup clock and 960MHz clock.
   Use as per Documentation/devicetree/bindings/clock/clock-bindings.txt
 - clock-names: should contain "wkupclk" and "refclk".

Optional properties:
 - ctrl-module : phandle of the control module used by PHY driver to power on
   the PHY.

This is usually a subnode of ocp2scp to which it is connected.

usb2phy@4a0ad080 {
        compatible = "ti,omap-usb2";
        reg = <0x4a0ad080 0x58>;
        ctrl-module = <&omap_control_usb>;
        #phy-cells = <0>;
	clocks = <&usb_phy_cm_clk32k>, <&usb_otg_ss_refclk960m>;
	clock-names = "wkupclk", "refclk";
};
```

## Documentation/devicetree/bindings/power/opp-modifier.txt
```
* OPP-Modifier - opp modifier to selectively enable operating point

OMAP devices that have selectively modifiable OPPs can specify
all available OPPs in their operating-points listing and then define
opp_modifiers to enable or disable the OPPs that are actually available
on the specific hardware.

* OPP Modifier Provider

properties:
- compatible : Should be "ti,opp-omap"
- reg : Address and length of the registers needed to identify available
	OPPs, here we provide efuse_sma address and device_id address

Optional Properties:
- ti,efuse-bit-enable-low: Take the complement of efuse before comparing mask
		     defined below under opp-modifier.

Sub-nodes:
Sub-nodes are defined as a container to hold opp modifier table for a
specific device with an operating-points table already defined

Sub-node properties:
- opp-modifier: A collection of rows consisting of the following entries to
		allow specification of available OPPs:
	-kHz: The opp to be enabled based on following criteria
	-Rev: The revision of the part this OPP applies to, specified
	      using OPP_REV macro
	-offset: Offset into efuse register where relevant bits are located
	-mask: Bit that indicates availability of OPP

The OPP_REV macro defined under include/dt-bindings/opp/am33xx.h allows
specification of specific part revision through usage:

	OPP_REV([MAJOR PART REVISION], [MINOR PART REVISION]);

so ES2.1 silicon for AM33XX would be indicated using OPP_REV(2,1);

Example:

	efuse_sma: efuse@0x44e107fc {
		compatible = "ti,opp-omap";
		reg = <0x44e107fc 0x04          /* EFUSE_SMA */
		       0x44e10600 0x04>;        /* DEVICE_ID */

		mpu_opp_modifier: mpu_opp_modifier {
			opp-modifier = <
			/* kHz   Rev		offset  mask */
			1000000  OPP_REV(2,1)	0	BIT_1
			720000   OPP_REV(1,0)	0	BIT_2
			>;
		};
	};

* OPP Modifier Consumer

Properties:
- platform-opp-modifier: phandle to the sub-node of the proper opp-modifier
		provider that contains the appropriate opp-modifier table

Example:

cpu@0 {
        compatible = "arm,cortex-a8";
        device_type = "cpu";

        operating-points = <
                /* kHz    uV */
                1000000 1351000
                720000  1285000
        >;

        platform-opp-modifier = <&mpu_opp_modifier>;
};
```

## Documentation/devicetree/bindings/regulator/pbias-regulator.txt
```
PBIAS internal regulator for SD card i/o pads on OMAP SoCs.

Required properties:
- compatible:
  - "regulator-pbias-omap2" for OMAP2
  - "regulator-pbias-omap3" for OMAP3
  - "regulator-pbias-omap4" for OMAP4
  - "regulator-pbias-omap5" for OMAP5, DRA7
- pbias-reg-offset: PBIAS control register offset from syscon base address

Optional properties:
- Any optional property defined in bindings/regulator/regulator.txt

Example:

		pbias_regulator: pbias_regulator {
			pbias-reg-offset = <0>;
			regulator-name = "pbias_regulator";
			regulator-min-microvolt = <1800000>;
			regulator-max-microvolt = <3000000>;
	};
```

## Documentation/devicetree/bindings/soc/sunxi/sram.txt
```
Allwinnner sun4i / sun5i / sun7i SoC SRAM controllers
-----------------------------------------------------

Required properties:
- compatible : "allwinner,sun4i-a10-sram-controller"
- reg : sram controller register offset + length

SRAM nodes
----------

Besides a node for the SRAM controller the devicetree must also contain a
node for each SRAM block controlled by the controller.

Required sram node properties:
- compatible : "allwinner,sun4i-a10-sram"
- allwinner,sram-name : should be one of
  * "A1"
  * "A2"
  * "A3-A4"
  * "D"

Example
-------

/*
 * Note we use the address where the mmio registers start, not where
 * the SRAM blocks start, this cannot be changed because that would be
 * a devicetree ABI change.
 */
soc@01c00000 {
	compatible = "simple-bus";
	#address-cells = <1>;
	#size-cells = <1>;
	ranges;

	sram@00000000 {
		compatible = "allwinner,sun4i-a10-sram";
		reg = <0x00000000 0x4000>;
		allwinner,sram-name = "A1";
	};

	sram@00004000 {
		compatible = "allwinner,sun4i-a10-sram";
		reg = <0x00004000 0x4000>;
		allwinner,sram-name = "A2";
	};

	sram@00008000 {
		compatible = "allwinner,sun4i-a10-sram";
		reg = <0x00008000 0x4000>;
		allwinner,sram-name = "A3-A4";
	};

	sram@00010000 {
		compatible = "allwinner,sun4i-a10-sram";
		reg = <0x00010000 0x1000>;
		allwinner,sram-name = "D";
	};

	sram-controller@01c00000 {
		compatible = "allwinner,sun4i-a10-sram-controller";
		reg = <0x01c00000 0x30>;
	};
};
```

## Documentation/devicetree/bindings/sound/mt8173-rt5650.txt
```
MT8173 with RT5650 CODECS

Required properties:
- compatible : "mediatek,mt8173-rt5650"
- mediatek,audio-codec: the phandles of rt5650 codecs
- mediatek,platform: the phandle of MT8173 ASoC platform

Optional properties:
- capture-dai: audio codec dai on capture path
  <&rt5650 0> : Default setting. Connect rt5650 I2S1 for capture. (dai_name = rt5645-aif1)
  <&rt5650 1> : Connect rt5650 I2S2 for capture. (dai_name = rt5645-aif2)

Example:

	sound {
		compatible = "mediatek,mt8173-rt5650";
		mediatek,audio-codec = <&rt5650>;
		mediatek,platform = <&afe>;
		capture-dai = <&rt5650 1>;
	};
```

## Documentation/devicetree/bindings/timer/snps,archs-gfrc.txt
```
Synopsys ARC Free Running 64-bit Global Timer for ARC HS CPUs
- clocksource provider for SMP SoC

Required properties:

- compatible : should be "snps,archs-gfrc"
- clocks     : phandle to the source clock

Example:

	timer@1 {
		compatible = "snps,archs-gfrc";
		clocks = <&core_clk>;
	};
```

## Documentation/devicetree/bindings/timer/snps,archs-rtc.txt
```
Synopsys ARC Free Running 64-bit Local Timer for ARC HS CPUs
- clocksource provider for UP SoC

Required properties:

- compatible : should be "snps,archs-rtc"
- clocks     : phandle to the source clock

Example:

	timer@1 {
		compatible = "snps,arc-rtc";
		clocks = <&core_clk>;
	};
```

## arch/arc/plat-axs10x/Kconfig
```kconfig
#
# Copyright (C) 2013 Synopsys, Inc. (www.synopsys.com)
#
# This program is free software; you can redistribute it and/or modify
# it under the terms of the GNU General Public License version 2 as
# published by the Free Software Foundation.
#

config ARC_PLAT_AXS10X
	bool "Synopsys ARC AXS10x Software Development Platforms"
	select COMMON_CLK
	select DW_APB_ICTL
	select ARCH_WANT_OPTIONAL_GPIOLIB
	help
	  Support for the ARC AXS10x Software Development Platforms.

	  The AXS10x Platforms consist of a mainboard with peripherals,
	  on which several daughter cards can be placed. The daughter cards
	  typically contain a CPU and memory.

if ARC_PLAT_AXS10X

config AXS101
	select DW_APB_GPIO_INTC
	bool "AXS101 with AXC001 CPU Card (ARC 770D/EM6/AS221)"
	help
	  This adds support for the 770D/EM6/AS221 CPU Card. Only the ARC
	  770D is supported in Linux.

	  The AXS101 Platform consists of an AXS10x mainboard with
	  this daughtercard. Please use the axs101.dts device tree
	  with this configuration.

endif
```
