## Documentation/devicetree/bindings/clock/ti/gate.txt
```
Binding for Texas Instruments gate clock.

This binding uses the common clock binding[1]. This clock is
quite much similar to the basic gate-clock [2], however,
it supports a number of additional features. If no register
is provided for this clock, the code assumes that a clockdomain
will be controlled instead and the corresponding hw-ops for
that is used.

[1] Documentation/devicetree/bindings/clock/clock-bindings.txt
[2] Documentation/devicetree/bindings/clock/gate-clock.txt
[3] Documentation/devicetree/bindings/clock/ti/clockdomain.txt

Required properties:
- compatible : shall be one of:
  "ti,gate-clock" - basic gate clock
  "ti,dss-gate-clock" - gate clock with DSS specific hardware handling
  "ti,am35xx-gate-clock" - gate clock with AM35xx specific hardware handling
  "ti,clkdm-gate-clock" - clockdomain gate clock, which derives its functional
			  clock directly from a clockdomain, see [3] how
			  to map clockdomains properly
  "ti,hsdiv-gate-clock" - gate clock with OMAP36xx specific hardware handling,
			  required for a hardware errata
- #clock-cells : from common clock binding; shall be set to 0
- clocks : link to phandle of parent clock
- reg : base address for register controlling adjustable gate, not needed for
	ti,clkdm-gate-clock type
- ti,enable-bit : bit shift for programming the clock gate, not needed for
		  ti,clkdm-gate-clock type

Optional properties:
- ti,set-bit-to-disable : inverts default gate programming. Setting the bit
  gates the clock and clearing the bit ungates the clock.

Examples:
	mmchs2_fck: mmchs2_fck@48004a00 {
		#clock-cells = <0>;
		compatible = "ti,gate-clock";
		clocks = <&core_96m_fck>;
		reg = <0x48004a00 0x4>;
		ti,enable-bit = <25>;
	};

	dss1_alwon_fck_3430es2: dss1_alwon_fck_3430es2@48004e00 {
		#clock-cells = <0>;
		compatible = "ti,dss-gate-clock";
		clocks = <&dpll4_m4x2_ck>;
		reg = <0x48004e00 0x4>;
		ti,enable-bit = <0>;
	};

	emac_ick: emac_ick@4800259c {
		#clock-cells = <0>;
		compatible = "ti,am35xx-gate-clock";
		clocks = <&ipss_ick>;
		reg = <0x4800259c 0x4>;
		ti,enable-bit = <1>;
	};

	emu_src_ck: emu_src_ck {
		#clock-cells = <0>;
		compatible = "ti,clkdm-gate-clock";
		clocks = <&emu_src_mux_ck>;
	};

	dpll4_m2x2_ck: dpll4_m2x2_ck@48004d00 {
		#clock-cells = <0>;
		compatible = "ti,hsdiv-gate-clock";
		clocks = <&dpll4_m2x2_mul_ck>;
		ti,enable-bit = <0x1b>;
		reg = <0x48004d00 0x4>;
		ti,set-bit-to-disable;
	};
```

## Documentation/devicetree/bindings/extcon/extcon-gpio-usbvid.txt
```
EXTCON FOR USB VIA GPIO

Required Properties:
 - compatible : Should be "ti,gpio-usb-vid" for USB VBUS-ID detector
		using gpios or "ti,gpio-usb-id" for USB ID pin detector
 - gpios : phandle and args ID pin gpio and VBUS gpio.
	   The first gpio used  for ID pin detection
	   and the second used for VBUS detection.
	   ID pin gpio is mandatory and VBUS is optional
	   depending on implementation.

Please refer to ../gpio/gpio.txt for details of the common GPIO bindings

Example:

	gpio_usbvid_extcon1 {
		compatible = "ti,gpio-usb-vid";
		gpios = <&gpio1 1 0>,
			<&gpio2 2 0>;
	};
```

## Documentation/devicetree/bindings/extcon/extcon-palmas.txt
```
EXTCON FOR PALMAS/TWL CHIPS

PALMAS USB COMPARATOR
Required Properties:
 - compatible : Should be "ti,palmas-usb-vid". "ti,twl6035-usb" and
   "ti,palmas-usb" is deprecated and is kept for backward compatibility.

Optional Properties:
 - ti,wakeup : To enable the wakeup comparator in probe
 - ti,enable-id-detection: Perform ID detection.
 - ti,enable-vbus-detection: Perform VBUS detection.

palmas-usb {
       compatible = "ti,twl6035-usb", "ti,palmas-usb";
       ti,wakeup;
};
```

## Documentation/devicetree/bindings/gpio/netxbig-gpio-ext.txt
```
Binding for the GPIO extension bus found on some LaCie/Seagate boards
(Example: 2Big/5Big Network v2, 2Big NAS).

Required properties:
- compatible: "lacie,netxbig-gpio-ext".
- addr-gpios: GPIOs representing the address register.
- data-gpios: GPIOs representing the data register.
- enable-gpio: GPIO used to enable the new configuration (address, data).

Example:

netxbig_gpio_ext: netxbig-gpio-ext {
	compatible = "lacie,netxbig-gpio-ext";

	addr-gpios = <&gpio1 15 GPIO_ACTIVE_HIGH
		      &gpio1 16 GPIO_ACTIVE_HIGH
		      &gpio1 17 GPIO_ACTIVE_HIGH>;
	data-gpios = <&gpio1 12 GPIO_ACTIVE_HIGH
		      &gpio1 13 GPIO_ACTIVE_HIGH
		      &gpio1 14 GPIO_ACTIVE_HIGH>;
	enable-gpio = <&gpio0 29 GPIO_ACTIVE_HIGH>;
};
```

## Documentation/devicetree/bindings/hwlock/hwlock.txt
```
Generic hwlock bindings
=======================

Generic bindings that are common to all the hwlock platform specific driver
implementations, the retrieved values are used for registering the device
specific parameters with the hwspinlock core.

The validity and need of these common properties may vary from one platform
implementation to another. The platform specific bindings should explicitly
state if a property is mandatory or optional. Please look through the
individual platform specific hwlock binding documentations for identifying
the applicable properties.

Common properties:
- hwlock-num-locks:	Number of locks present in a hwlock device. This
			property is needed on hwlock devices, where the number
			of supported locks within a hwlock device cannot be
			read from a register.

Hwlock Users:
=============

Nodes that require specific hwlock(s) should specify them using one or more
properties, each containing a phandle to the hwlock node and a 0-indexed
relative hwlock number within that hwlock node. Multiple hwlocks can be
requested using an array of the phandle and hwlock number specifier tuple.

1. Example of a node using a single specific hwlock:

The following example has a node requesting third hwlock in the bank
defined by the node hwlock1.

	node {
		...
		hwlocks = <&hwlock1 2>;
		...
	};

2. Example of a node using multiple specific hwlocks:

The following example has a node requesting two hwlocks, third hwlock within
the hwlock device node 'hwlock1', and the first hwlock within the hwlock
device node 'hwlock2'.

	node {
		...
		hwlocks = <&hwlock1 2>, <&hwlock2 0>;
		...
	};
```

## Documentation/devicetree/bindings/hwlock/omap-hwspinlock.txt
```
OMAP4+ HwSpinlock Driver
========================

Required properties:
- compatible:		Should be "ti,omap4-hwspinlock" for
			    OMAP44xx, OMAP54xx, AM33xx, AM43xx, DRA7xx SoCs
- reg:			Contains the hwspinlock module register address space
			(base address and length)
- ti,hwmods:		Name of the hwmod associated with the hwspinlock device


Example:

/* OMAP4 */
hwspinlock: spinlock@4a0f6000 {
	compatible = "ti,omap4-hwspinlock";
	reg = <0x4a0f6000 0x1000>;
	ti,hwmods = "spinlock";
};
```

## Documentation/devicetree/bindings/i2c/i2c-suspend-resume.txt
```
I2C suspend/resume sequences

This provides the ability for a simple I2C sequence to be written at
suspend time and resume time. This is for sequences that cannot be written
by the I2C bus driver for reasons such as needing to be run from SRAM
or needing to be written by firmware.

The sequence is composed of messages. Each message contains a length byte,
an address byte, and then the message.

Optional properties:
- sleep-sequence
	I2C sequence to write during suspend

- wake-sequence
	I2C sequence to write during wake

Examples :

i2c0: i2c@0 {
	/* Set OPP50 (0.95V) for VDD core on TPS65217 */
	sleep-sequence = /bits/ 8 <
		0x02 0x24 0x0b 0x6d /* Password unlock 1 */
		0x02 0x24 0x10 0x02 /* Set DCDC3 to 0.95V */
		0x02 0x24 0x0b 0x6d /* Password unlock 2 */
		0x02 0x24 0x10 0x02 /* Set DCDC3 to 0.95V */
		0x02 0x24 0x0b 0x6c /* Password unlock 1 */
		0x02 0x24 0x11 0x86 /* Apply DCDC changes */
		0x02 0x24 0x0b 0x6c /* Password unlock 2 */
		0x02 0x24 0x11 0x86 /* Apply DCDC changes */
	>;

	/* Set OPP100 (1.10V) for VDD core */
	wake-sequence = /bits/ 8 <
		0x02 0x24 0x0b 0x6d /* Password unlock 1 */
		0x02 0x24 0x10 0x08 /* Set DCDC3 to 1.1V */
		0x02 0x24 0x0b 0x6d /* Password unlock 2 */
		0x02 0x24 0x10 0x08 /* Set DCDC3 to 1.1V */
		0x02 0x24 0x0b 0x6c /* Password unlock 1 */
		0x02 0x24 0x11 0x86 /* Apply DCDC changes */
		0x02 0x24 0x0b 0x6c /* Password unlock 2 */
		0x02 0x24 0x11 0x86 /* Apply DCDC changes */
	>;
}
```

## Documentation/devicetree/bindings/input/touchscreen/pixcir_i2c_ts.txt
```
* Pixcir I2C touchscreen controllers

Required properties:
- compatible: must be "pixcir,pixcir_ts" or "pixcir,pixcir_tangoc"
- reg: I2C address of the chip
- interrupts: interrupt to which the chip is connected
- attb-gpio: GPIO connected to the ATTB line of the chip
- x-size: horizontal resolution of touchscreen
- y-size: vertical resolution of touchscreen

Example:

	i2c@00000000 {
		/* ... */

		pixcir_ts@5c {
			compatible = "pixcir,pixcir_ts";
			reg = <0x5c>;
			interrupts = <2 0>;
			attb-gpio = <&gpf 2 0 2>;
			x-size = <800>;
			y-size = <600>;
		};

		/* ... */
	};
```

## Documentation/devicetree/bindings/leds/leds-rt5033.txt
```
* Richtek Technology Corporation - RT5033 Flash LED Driver

The RT5033 Flash LED Circuit is designed for one or two LEDs driving
for torch and strobe applications, it provides an I2C software command
to trigger the torch and strobe operation.

There are two LED outputs available - FLED1 and FLED2. Each of them can
control a separate LED or they can be connected together to double
the maximum current for a single connected LED. One LED is represented
by one child node.

Required properties:
- compatible : Must be "richtek,rt5033-led".

A discrete LED element connected to the device must be represented by a child
node - see Documentation/devicetree/bindings/leds/common.txt.

Required properties for the LED child node:
  See Documentation/devicetree/bindings/leds/common.txt
- led-sources : device current output identifiers:  0 - FLED1, 1 - FLED2
- led-max-microamp : 12.5mA to 200mA, step by 12.5mA.
- flash-max-microamp :
	Turn on one LED channel : 50mA to 800mA, step by 25mA.
	Turn on two LED channels : 50mA to 600mA, step by 25mA.
- flash-max-timeout-us : 64ms to 1216ms, step by 32ms.

Optional properties for the LED child node:
- label : see Documentation/devicetree/bindings/leds/common.txt

Example:

rt5033 {
	compatible = "richtek,rt5033";

	led {
		compatible = "richtek,rt5033-led";

		flash-led {
			label = "rt5033-flash";
			led-sources = <0>, <1>;
			led-max-microamp = <200000>;
			flash-max-microamp = <800000>;
			flash-max-timeout-us = <1216000>;
		};
	};
}
```

## Documentation/devicetree/bindings/leds/leds-sn3218.txt
```
* Si-En Technology - SN3218 18-Channel LED Driver

Required properties:
- compatible :
	"si-en,sn3218"
- address-cells : must be 1
- size-cells : must be 0
- reg : I2C slave address, typically 0x54

There must be at least 1 LED which is represented as a sub-node
of the sn3218 device.

LED sub-node properties:
- label : (optional) see Documentation/devicetree/bindings/leds/common.txt
- reg : number of LED line (could be from 0 to 17)
- linux,default-trigger : (optional)
   see Documentation/devicetree/bindings/leds/common.txt

Example:

sn3218: led-controller@54 {
	compatible = "si-en,sn3218";
	#address-cells = <1>;
	#size-cells = <0>;
	reg = <0x54>;

	led@0 {
		label = "led1";
		reg = <0x0>;
	};

	led@1 {
		label = "led2";
		reg = <0x1>;
	};

	led@2 {
		label = "led3";
		reg = <0x2>;
	};
};
```

## Documentation/devicetree/bindings/mailbox/omap-mailbox.txt
```
OMAP2+ Mailbox Driver
=====================

The OMAP mailbox hardware facilitates communication between different
processors using a queued mailbox interrupt mechanism. The IP block is
external to the various processor subsystems and is connected on an
interconnect bus. The communication is achieved through a set of
registers for message storage and interrupt configuration registers.

Each mailbox IP block has a certain number of h/w fifo queues and output
interrupt lines. An output interrupt line is routed to a specific interrupt
controller on a processor subsystem, and there can be more than one line
going to a specific processor's interrupt controller. The interrupt line
connections are fixed for an instance and are dictated by the IP integration
into the SoC. Each interrupt line is programmable through a set of interrupt
configuration registers, and have a rx and tx interrupt source per h/w fifo.
Communication between different processors is achieved through the appropriate
programming of the rx and tx interrupt sources on the appropriate interrupt
lines.

The number of h/w fifo queues and interrupt lines dictate the usable registers.
All the current OMAP SoCs except for the newest DRA7xx SoC has a single IP
instance. DRA7xx has multiple instances with different number of h/w fifo
queues and interrupt lines between different instances. The interrupt lines
can also be routed to different processor sub-systems on DRA7xx as they are
routed through the Crossbar, a kind of interrupt router/multiplexer.

The above two varying SoC IP integration parameters are defined specifically
through the "ti,mbox-num-users" and "ti,mbox-num-fifos" device-tree properties.
These are defined in the DT nodes since these design parameters can vary between
one instance to another in an SoC (eg: DRA7xx) even though the base IP design
is identical.

Required properties:
--------------------
- compatible:		Should be one of the following,
			    "ti,omap2-mailbox" for
				OMAP2420, OMAP2430, OMAP3430, OMAP3630 SoCs
			    "ti,omap4-mailbox" for
				OMAP44xx, OMAP54xx, AM33xx, AM43xx, DRA7xx SoCs
- reg:			Contains the mailbox register address range (base address
			and length)
- interrupts: 		Contains the interrupt information for the mailbox
			device. The format is dependent on which interrupt
			controller the OMAP device uses
- ti,hwmods:		Name of the hwmod associated with the mailbox
- ti,mbox-num-users:	Number of targets (processor devices) that the mailbox device
			can interrupt
- ti,mbox-num-fifos:	Number of h/w fifos within the mailbox device
- ti,mbox-names:	Array of the names of the mailboxes
- ti,mbox-data:		Mailbox descriptor data private to each mailbox. The 4
			cells represent the following data,
			  Cell #1 (tx_id) - mailbox fifo id used for
						transmitting messages
			  Cell #2 (rx_id) - mailbox fifo id on which messages
						are received
			  Cell #3 (irq_id) - irq identifier index number to use
						from the interrupts data
			  Cell #4 (usr_id) - mailbox user id for identifying the
						interrupt into the MPU interrupt
						controller.

Example:
--------

/* OMAP4 */
mailbox: mailbox@4a0f4000 {
	compatible = "ti,omap4-mailbox";
	reg = <0x4a0f4000 0x200>;
	interrupts = <GIC_SPI 47 IRQ_TYPE_LEVEL_HIGH>;
	ti,hwmods = "mailbox";
	ti,mbox-num-users = <3>;
	ti,mbox-num-fifos = <8>;
	ti,mbox-names = "mbox-ipu", "mbox-dsp";
	ti,mbox-data = <0 1 0 0>, <3 2 0 0>;
};
```

## Documentation/devicetree/bindings/mfd/tps65218.txt
```
The TPS65218 Integrated Power Management Chips.
These chips are connected to an i2c bus.

Required properties:
- compatible : Must be "ti,tps65218";
- interrupts : This i2c device has an IRQ line connected to the main SoC
- interrupt-controller : Since the tps65218 support several interrupts
  internally, it is considered as an interrupt controller cascaded to the SoC.
- #interrupt-cells = <2>;
- interrupt-parent : The parent interrupt controller.

Optional node:
- Child nodes contain in the tps65218.
  It supports a number of features.
  The children nodes will thus depend of the capability of the variant.

Example:
/*
 * Integrated Power Management Chip
 */
tps@24 {
    compatible = "ti,tps65218";
    reg = <0x24>;
    interrupt-controller;
    #interrupt-cells = <2>;
    interrupt-parent = <&gic>;
};
```
