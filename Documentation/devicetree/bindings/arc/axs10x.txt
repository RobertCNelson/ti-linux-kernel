## Documentation/devicetree/bindings/arc/axs10x.txt
```
Synopsys DesignWare ARC Software Development Platforms Device Tree Bindings
---------------------------------------------------------------------------

SDP boards with Synopsys ARC700 core shall have the following properties.

Required root node properties:
    - compatible = "snps,axs101", "snps,arc-sdp";
```

## Documentation/devicetree/bindings/arm/omap/crossbar.txt
```
* TI - IRQ/DMA Crossbar

This version is an implementation of the Crossbar IRQ/DMA IP

Required properties:
- compatible : Should be "ti,dra-crossbar"
- crossbar-name: Name of the controller to which crossbar output is routed
- reg:	Contains crossbar register address range
- reg-width: Represents the width of the individual registers
- crossbar-lines:  Default mappings.Should contain the crossbar-name
		   device name, int/dma request number, crossbar number,
		   register offset in the same order.

Examples:
		crossbar_mpu: mpuirq@4a002a48 {
			compatible = "crossbar";
			crossbar-name = "mpu-irq";
			reg = <0x4a002a48 0x0130>;
			reg-width = <16>;
			crossbar-lines = "mpu-irq", "rtc-ss-alarm", <0x9f 0xd9 0x12c>,
					 "mpu-irq", "mcasp3-arevt", <0x9e 0x96 0x12a>,
					 "mpu-irq", "mcasp3-axevt", <0x9d 0x97 0x128>;
		};
```

## Documentation/devicetree/bindings/arm/samsung/exynos-srom.txt
```
SAMSUNG Exynos SoCs SROM Controller driver.

Required properties:
- compatible : Should contain "samsung,exynos-srom".

- reg: offset and length of the register set

Example:
	sromc@12570000 {
		compatible = "samsung,exynos-srom";
		reg = <0x12570000 0x10>;
	};
```

## Documentation/devicetree/bindings/arm/ti/k3.txt
```
Texas Instruments K3 device tree bindings
-------------------------------------------

Boards based on the K3 family of SoCs shall have the following property:
- compatible: Every device present in K3 SoC shall be in the form:
  "ti,XXX-YYY", where:
     'XXX' represents the specific SoC part for which the support is added.
     'YYY' represents the corresponding peripheral in SoC being supported.
  NOTE: Generic devices such as GIC, NS16550 type UART shall use the specified
  compatible for those devices.

  Example:
    compatible = "ti,am654-i2c";

SoCs
-------------------------------------------

Each device tree root node must specify which exact K3 SoC it uses, using one
of the following compatible values:

- AM654
  compatible = "ti,am654";

Boards
-------------------------------------------

In addition, each device tree root node must specify which one or more of the
following board-specific compatible values:

- AM654 EVM
  compatible = "ti,am654-evm", "ti,am654";
```

## Documentation/devicetree/bindings/ata/ti-sata.txt
```
* Texas Instruments SATA Controller Wrapper

Required properties:
- compatible	: "ti,sata"
- ti,hwmods	: "sata"
- reg		: Register mapping
- #address-cells: <1>
- #size-cells	: <1>
- ranges	: allows valid translation between child's address space and parent's
		  address space.
- Must contain at least one child node for the SATA controller core

Example:

	sata: sata@4a141100 {
		compatible = "ti,sata";
		ti,hwmods = "sata";
		reg = <0x4a141100 0x7>;
		#address-cells = <1>;
		#size-cells = <1>;
		ranges;
		dwc-ahci@4a140000 {
			compatible = "snps,dwc-ahci";
			reg = <0x4a140000 0x1100>;
			interrupts = <GIC_SPI 54 IRQ_TYPE_LEVEL_HIGH>;
			phys = <&sata_phy>;
			phy-names = "sata-phy";
			clocks = <&sata_ref_clk>;
			clock-names = "optclk";
		};
	};
```

## Documentation/devicetree/bindings/bus/simple-pm-bus.txt
```
Simple Power-Managed Bus
========================

A Simple Power-Managed Bus is a transparent bus that doesn't need a real
driver, as it's typically initialized by the boot loader.

However, its bus controller is part of a PM domain, or under the control of a
functional clock.  Hence, the bus controller's PM domain and/or clock must be
enabled for child devices connected to the bus (either on-SoC or externally)
to function.


Generic compatible values and properties
----------------------------------------

Required properties:
  - compatible: Must be at least one of the vendor-specific compatible values
		from a vendor-specific section below, and "simple-bus" as a
		fallback.
  - #address-cells, #size-cells, ranges: Must describe the mapping between
		parent address and child address spaces.

Optional platform-specific properties for clock or PM domain control (at least
one of them is required):
  - clocks: Must contain a reference to the functional clock(s),
  - power-domains: Must contain a reference to the PM domain.


Vendor-specific compatible values and properties
------------------------------------------------

Renesas Bus State Controller (BSC):
  - compatible: Must be an SoC-specific value, and "renesas,bsc" as a fallback.
                SoC-specific values can be:
		"renesas,bsc-r8a73a4" for R-Mobile APE6 (r8a73a4)
		"renesas,bsc-sh73a0" for SH-Mobile AG5 (sh73a0)
  - reg: Must contain the base address and length to access the bus controller.
  - interrupts: Must contain a reference to the BSC interrupt, if available.


Example:

	bsc: bus@fec10000 {
		compatible = "renesas,bsc-sh73a0", "renesas,bsc", "simple-bus";
		#address-cells = <1>;
		#size-cells = <1>;
		ranges = <0 0 0x20000000>;
		reg = <0xfec10000 0x400>;
		interrupts = <0 39 IRQ_TYPE_LEVEL_HIGH>;
		clocks = <&zb_clk>;
		power-domains = <&pd_a4s>;
	};
```

## Documentation/devicetree/bindings/clock/clk-palmas.txt
```
* Palmas 32KHz clocks *

Palmas device has two clock output pins for 32KHz, KG and KG_AUDIO.

This binding uses the common clock binding ./clock-bindings.txt.

Required properties:
- compatible : shall be "ti,palmas-clk".
- #clock-cells : from common clock binding; shall be set to 1. The clock id for
		different clocks are:
			0 for CLK32K_KG
			1 for CLK32K_KG_AUDIO.
		The macros of clocks id for DTS is defined at
			dt-bindings/mfd/palmas.h

Optional subnode:
	The clock node has optional subnode to provide the init configuration of
	clocks like sleep control.

	The subnode name is fixed and it should be
		clk32k_kg for the 32KHz KG clock.
		clk32k_kg_audio for the 32KHz KG_AUDIO clock.

	Optional subnode properties:
	ti,external-sleep-control: The external enable input pins controlled the
		enable/disable of clocks.  The external enable input pins ENABLE1,
		ENABLE2 and NSLEEP. The valid values for the external pins are:
			1 for ENABLE1
			2 for ENABLE2
			3 for NSLEEP.
		Option 0 or missing this property means the clock is
		enabled/disabled via register access and these pins do
		not have any control.
		The macros of external control pins for DTS is defined at
			dt-bindings/mfd/palmas.h

Example:
	#include <dt-bindings/mfd/palmas.h>
	...
	palmas: tps65913@58 {
		...
		clock {
			compatible = "ti,palmas-clk";
			#clock-cells = <1>;
			clk32k_kg {
				ti,external-sleep-control = <PALMAS_EXT_CONTROL_PIN_NSLEEP>;
			};
		};
		...
	};
```

## Documentation/devicetree/bindings/clock/gate-clock.txt
```
Binding for simple gate clock.

This binding uses the common clock binding[1].  It assumes a
register-mapped clock gate controlled by a single bit that has only one
input clock or parent.  By default setting the specified bit gates the
clock signal and clearing the bit ungates it.

The binding must provide the register to control the gate and the bit
shift for the corresponding gate control bit. Some clocks set the bit to
gate the clock signal, and clear it to ungate the clock signal. The
optional "set-bit-to-disable" specifies this behavior.

[1] Documentation/devicetree/bindings/clock/clock-bindings.txt

Required properties:
- compatible : shall be "gate-clock".
- #clock-cells : from common clock binding; shall be set to 0.
- clocks : link to phandle of parent clock
- reg : base address for register controlling adjustable gate
- bit-shift : bit shift for programming the clock gate

Optional properties:
- clock-output-names : from common clock binding.
- set-bit-to-disable : inverts default gate programming. Setting the bit
  gates the clock and clearing the bit ungates the clock.
- hiword-mask : lower half of the register controls the gate, upper half
  of the register indicates bits that were updated in the lower half

Examples:
	clock_foo: clock_foo@4a008100 {
		compatible = "gate-clock";
		#clock-cells = <0>;
		clocks = <&clock_bar>;
		reg = <0x4a008100 0x4>
		bit-shift = <3>
	};
```

## Documentation/devicetree/bindings/clock/ti/autoidle.txt
```
Binding for Texas Instruments autoidling clock.

This binding uses the common clock binding[1]. Autoidle clocks
are inherited clocks from basic divider-clock [2] or
fixed-factor-clock [3] and just add autoidle support on top of
this. Autoidle is an OMAP clock feature, which allows the clock
to gate autonomously by hardware when they are no longer needed.
The autoidle feature must be enabled manually for these clocks.
Otherwise the clocks behave exactly as their base clock type.

[1] Documentation/devicetree/bindings/clock/clock-bindings.txt
[2] Documentation/devicetree/bindings/clock/divider-clock.txt
[3] Documentation/devicetree/bindings/clock/fixed-factor-clock.txt

Required properties:
- compatible : shall be one of:
		"ti,divider-clock",
		"ti,fixed-factor-clock"
- ti,autoidle-shift : bit shift of the autoidle enable bit for the clock
- reg : base address for the control register of this clock

Optional properties:
- ti,autoidle-low : autoidle is enabled by setting the bit to 0

Other properties as per the base clock type.

Examples:
	dpll_abe_m2x2_ck: dpll_abe_m2x2_ck@4a0051f0 {
		#clock-cells = <0>;
		compatible = "ti,divider-clock";
		clocks = <&dpll_abe_x2_ck>;
		ti,autoidle-shift = <8>;
		reg = <0x4a0051f0 0x4>;
		bit-mask = <0x1f>;
		index-starts-at-one;
		ti,autoidle-low;
	};

	dpll_usb_clkdcoldo_ck: dpll_usb_clkdcoldo_ck@4a0081b4 {
		#clock-cells = <0>;
		compatible = "ti,fixed-factor-clock";
		clocks = <&dpll_usb_ck>;
		ti,autoidle-shift = <8>;
		clock-div = <1>;
		reg = <0x4a0081b4 0x4>;
		clock-mult = <1>;
		ti,autoidle-low;
	};
```

## Documentation/devicetree/bindings/clock/ti/dpll.txt
```
Binding for Texas Instruments DPLL clock.

This binding uses the common clock binding[1].  It assumes a
register-mapped DPLL with usually two selectable input clocks
(reference clock and bypass clock), with digital phase locked
loop logic for multiplying the input clock to a desired output
clock. This clock also typically supports different operation
modes (locked, low power stop etc.) This binding has several
sub-types, which effectively result in slightly different setup
for the actual DPLL clock.

[1] Documentation/devicetree/bindings/clock/clock-bindings.txt

Required properties:
- compatible : shall be one of:
		"ti,omap4-dpll-x2-clock",
		"ti,omap3-dpll-clock",
		"ti,omap3-dpll-core-clock",
		"ti,omap3-dpll-per-clock",
		"ti,omap3-dpll-per-j-type-clock",
		"ti,omap4-dpll-clock",
		"ti,omap4-dpll-core-clock",
		"ti,omap4-dpll-m4xen-clock",
		"ti,omap4-dpll-j-type-clock",
		"ti,omap4-dpll-no-gate-clock",
		"ti,omap4-dpll-no-gate-j-type-clock",

- #clock-cells : from common clock binding; shall be set to 0.
- clocks : link phandles of parent clocks, first entry lists reference clock
  and second entry bypass clock
- reg : address and length of the register set for controlling the DPLL.
  It contains the information of registers in the same order as described by
  reg-names.
- reg-names : array of the register names for controlling the device, sorted
  in the same order as the reg property.
	"control" - contains the control register base address
        "idlest" - contains the idle status register base address
        "autoidle" - contains the autoidle register base address
        "mult-div1" - contains the multiplier / divider register base address

Optional properties:
- ti,modes : available modes for the DPLL, bitmask of:
  0x02 - DPLL supports low power stop mode
  0x20 - DPLL can be put to low power bypass mode
  0x80 - DPLL can be put to lock mode (running)
  Other values currently unsupported.
- ti,clkdm-name : clockdomain name for the DPLL

Examples:
	dpll_core_ck: dpll_core_ck@44e00490 {
		#clock-cells = <0>;
		compatible = "ti,omap4-dpll-core-clock";
		clocks = <&sys_clkin_ck>, <&sys_clkin_ck>;
		reg = <0x44e00490 0x4>, <0x44e0045c 0x4>, <0x0 0x4>,
				<0x44e00468 0x4>;
		reg-names = "control", "idlest", "autoidle", "mult-div1";
	};

	dpll2_ck: dpll2_ck@48004004 {
		#clock-cells = <0>;
		compatible = "ti,omap3-dpll-clock";
		clocks = <&sys_ck>, <&dpll2_fck>;
		ti,modes = <0xa2>;
		reg = <0x48004004 0x4>, <0x48004024 0x4>, <0x48004034 0x4>,
			<0x48004040 0x4>;
		reg-names = "control", "idlest", "autoidle", "mult-div1";
		ti,clkdm-name = "dpll2_clkdm";
	};
```

## Documentation/devicetree/bindings/clock/ti/dra7-atl.txt
```
Device Tree Clock bindings for ATL (Audio Tracking Logic) of DRA7 SoC.

This binding uses the common clock binding[1].
The ATL IP is used to generate clock to be used to synchronize baseband and
audio codec.
ATL can maintain a clock averages to some desired frequency based on the bws/aws
signals - can compensate the drift between the two ws signal.

[1] Documentation/devicetree/bindings/clock/clock-bindings.txt

Required properties:
- compatible : shall be "ti,dra7-atl-clock"
- #clock-cells : from common clock binding; shall be set to 1.
- clocks : link phandles to functional clock of ATL
- clock-names : Shall be set to "fck"
- reg : base address for the ATL IP
- ti,hwmods : Shall be set to "atl"

Optional properties:
- fck_parent : Should contain a valid clock name which will be used as parent
	       for the ATL fck
Configuration of ATL instances:
- atl{0/1/2/3} {
	- bws : Baseband word select signal selection
	- aws : Audio word select signal selection
};

For valid word select signals, see the dt-bindings/clk/ti-dra7-atl.h include
file.

Examples:
atl_clkin: atl@0x4843c000 {
	compatible = "ti,dra7-atl-clock";
	reg = <0x4843c000 0x3ff>;
	ti,hwmods = "atl";
	#clock-cells = <1>;
	clocks = <&atl_gfclk_mux>;
	clock-names = "fck";
	status = "disabled";
};

#include <dt-bindings/clk/ti-dra7-atl.h>

&atl_clkin {
	fck_parent = "dpll_abe_m2_ck";
	status = "okay";

	atl2 {
		bws = <DRA7_ATL_WS_MCASP2_FSX>;
		aws = <DRA7_ATL_WS_MCASP3_FSX>;
	};
};
```
