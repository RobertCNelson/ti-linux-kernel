// SPDX-License-Identifier: GPL-2.0
/*
 * Device Tree Source for DRA8 SoC Family MCU/WAKEUP Domain peripherals
 *
 * Copyright (C) 2016-2018 Texas Instruments Incorporated - http://www.ti.com/
 */

&cbass_mcu_wakeup {
	mcu_uart0: serial@42300000 {
		compatible = "ti,am654-uart";
		reg = <0x42300000 0x100>;
		reg-shift = <2>;
		reg-io-width = <4>;
		interrupts = <GIC_SPI 897 IRQ_TYPE_LEVEL_HIGH>;
		clock-frequency = <48000000>;
		current-speed = <115200>;
	};

	mcu_uart1: serial@40a00000 {
		compatible = "ti,am654-uart";
			reg = <0x40a00000 0x100>;
			reg-shift = <2>;
			reg-io-width = <4>;
			interrupts = <GIC_SPI 846 IRQ_TYPE_LEVEL_HIGH>;
			clock-frequency = <96000000>;
			current-speed = <115200>;
	};
};
